## boards/shields/re-gret/Kconfig.shield
```kconfig
config SHIELD_REGRET
    def_bool $(shields_list_contains,re-gret)
    select SPI
```

## config/west.yml
```yaml
manifest:
  remotes:
    - name: zmkfirmware
      url-base: https://github.com/zmkfirmware
    - name: rschenk
      url-base: https://github.com/rschenk
  projects:
    - name: zmk
      remote: zmkfirmware
      revision: v0.3
      import: app/west.yml
    - name: zmk-keyboard-re-gret
      remote: rschenk
      revision: v0.3

  self:
    path: config
```
